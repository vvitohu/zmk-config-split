## boards/shields/3x4macrokeyboard/Kconfig.defconfig
```kconfig
# Copyright (c) 2020 The ZMK Contributors
# SPDX-License-Identifier: MIT

if SHIELD_BOARDSOURCE3X4

config ZMK_KEYBOARD_NAME
    default "boardsource3x4"

config ZMK_SPLIT_ROLE_CENTRAL
    default n

config ZMK_SPLIT
    default n

# Set this to the number of peripherals your dongle will have.
# For a unibody, this would be 1. If you have left and right halves, set it to 2, etc.
config ZMK_SPLIT_BLE_CENTRAL_PERIPHERALS
    default 1

# Set this to ZMK_SPLIT_BLE_CENTRAL_PERIPHERALS + your desired number of BT profiles (default is 5)
config BT_MAX_CONN
    default 3

# Set this to the same number as BT_MAX_CONN
config BT_MAX_PAIRED
    default 3

CONFIG_CLOCK_CONTROL_NRF_K32SRC_RC=y

CONFIG_ZMK_BACKLIGHT=y

config ZMK_SLEEP
    default y
    
config ZMK_IDLE_SLEEP_TIMEOUT
    default 900000
    
config ZMK_EXT_POWER
    default y

config ZMK_BATTERY_REPORTING
    default y

config ZMK_BATTERY_REPORT_INTERVAL
    default 60

if ZMK_DISPLAY

config I2C
    default y

config SSD1306
    default y
    
endif # ZMK_DISPLAY 

config RGBLED_WIDGET_LAYER_BLINK_MS
    default 100

endif
```

## boards/shields/3x4macrokeyboard/Kconfig.shield
```kconfig
# Copyright (c) 2020 The ZMK Contributors
# SPDX-License-Identifier: MIT

config SHIELD_3X4MACROKEYBOARD
    def_bool $(shields_list_contains,3x4macrokeyboard)
```

## boards/shields/Split/Kconfig.defconfig
```kconfig
if SHIELD_SPLIT_LEFT

config ZMK_KEYBOARD_NAME
    default "Split"

config ZMK_SPLIT_ROLE_CENTRAL
    default y

endif

if SHIELD_SPLIT_LEFT || SHIELD_SPLIT_RIGHT

config ZMK_SPLIT
    default y

CONFIG_ZMK_SPLIT_BLE
    default y

CONFIG_ZMK_SPLIT_WIRED
    default n

CONFIG_ZMK_SPLIT_BLE_CENTRAL_PERIPHERALS=1

CONFIG_ZMK_SPLIT_BLE_CENTRAL_BATTERY_LEVEL_PROXY
    default y


endif
```

## boards/shields/Split/Kconfig.shield
```kconfig
# Copyright (c) 2020 The ZMK Contributors
# SPDX-License-Identifier: MIT

config SHIELD_SPLIT_LEFT
    def_bool $(shields_list_contains,Split_left)

config SHIELD_SPLIT_RIGHT
    def_bool $(shields_list_contains,Split_right)
    
```

## boards/shields/macrokeyboard/Kconfig.shield
```kconfig
# Copyright (c) 2020 The ZMK Contributors
# SPDX-License-Identifier: MIT

config SHIELD_MACROKEYBOARD
    def_bool $(shields_list_contains,macrokeyboard)
```

## boards/shields/splitkeyboard/Kconfig.shield
```kconfig
# Copyright (c) 2020 The ZMK Contributors
# SPDX-License-Identifier: MIT

config SHIELD_SPLIT_LEFT
    def_bool $(shields_list_contains,split_left)

config SHIELD_SPLIT_RIGHT
    def_bool $(shields_list_contains,split_right)
    
```

## config/boards/shields/boardsource3x4/Kconfig.defconfig
```kconfig
# Copyright (c) 2020 The ZMK Contributors
# SPDX-License-Identifier: MIT

if SHIELD_BOARDSOURCE3X4

config ZMK_KEYBOARD_NAME
    default "boardsource3x4"

endif
```

## config/west.yml
```yaml
manifest:
  defaults:
    revision: v0.2
  remotes:
    - name: zmkfirmware
      url-base: https://github.com/zmkfirmware
    # Additional modules containing boards/shields/custom code can be listed here as well
    # See https://docs.zephyrproject.org/3.2.0/develop/west/manifest.html#projects
    - name: caksoylar  # <-- new entry
      url-base: https://github.com/caksoylar
  projects:
    - name: zmk
      remote: zmkfirmware
      import: app/west.yml
    - name: zmk-rgbled-widget  # <-- new entry
      remote: caksoylar
      revision: main
  self:
    path: config
```
