/ {
    kscan0: kscan {
        compatible = "zmk,kscan-gpio-matrix";
        row-gpios = <&gpio0 17 GPIO_ACTIVE_LOW>,
                    <&gpio0 22 GPIO_ACTIVE_LOW>,
                    <&gpio0 24 GPIO_ACTIVE_LOW>;
        col-gpios = <&gpio1 10 GPIO_ACTIVE_LOW>,
                    <&gpio1 4 GPIO_ACTIVE_LOW>,
                    <&gpio1 6 GPIO_ACTIVE_LOW>,
                    <&gpio1 15 GPIO_ACTIVE_LOW>;
        debounce-period-ms = <5>;
    };
};