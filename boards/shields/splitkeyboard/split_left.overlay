#include "splitkeyboard.dtsi"


    &transform {
        col-offset = <3>;
    };

    &kscan {
        col-gpios = <&pro_micro 5 GPIO_ACTIVE_HIGH>,
                    <&pro_micro 4 GPIO_ACTIVE_HIGH>,
                    <&pro_micro 3 GPIO_ACTIVE_HIGH>;
                    
    };

